## CMakeLists.txt
```
cmake_minimum_required(VERSION 3.20.0)
find_package(Zephyr REQUIRED HINTS $ENV{ZEPHYR_BASE})
project(gnss_project)
target_sources(app PRIVATE src/main.c)
```

## prj.conf
```kconfig
CONFIG_NRF_MODEM_LIB=y
# UART1 is connected to the DK's VCOM0.  Do not reserve it for TF-M logging.
CONFIG_TFM_LOG_LEVEL_SILENCE=y
```

## app.overlay
```dts
/ {
	chosen {
		zephyr,console = &uart1;
		zephyr,shell-uart = &uart1;
	};
};

/* UART1 is the nRF9161 DK VCOM0 interface. */
&uart1 {
	status = "okay";
};
```

## src/main.c
```c
#include <zephyr/kernel.h>
#include <zephyr/sys/printk.h>

#include <modem/nrf_modem_lib.h>
#include <nrf_modem_gnss.h>

int main(void)
{
    int err;

    printk("GNSS project started\n");

    err = nrf_modem_lib_init();
    if (err) {
        printk("Modem library initialization failed: %d\n", err);
        return 0;
    }

    printk("Modem library initialized\n");

    return 0;
}
```
