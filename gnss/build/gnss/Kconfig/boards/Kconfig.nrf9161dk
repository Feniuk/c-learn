## gnss/build/gnss/Kconfig/boards/Kconfig.nrf9161dk
```kconfig
# Load board Kconfig descriptions.
osource "C:/ncs/v3.4.0/zephyr/boards/nordic/nrf9161dk/Kconfig.nrf9161dk"
```

## l3Ex2my/build/Kconfig/boards/Kconfig
```kconfig
# Load Zephyr board Kconfig descriptions.
osource "C:/ncs/v3.4.0/zephyr/boards/nordic/nrf9161dk/Kconfig"
config BOARD_REVISION_0_9_0
	def_bool y
```
